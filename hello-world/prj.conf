## CMakeLists.txt
```
# SPDX-License-Identifier: Apache-2.0

cmake_minimum_required(VERSION 3.20.0)

get_filename_component(ZEPHYR_RUST ${CMAKE_CURRENT_SOURCE_DIR}/../.. ABSOLUTE)

message(STATUS "Zephyr Rust module: ${ZEPHYR_RUST}")

find_package(Zephyr)

project(hello_world)

target_sources(app PRIVATE ./src/main.c)
```

## prj.conf
```kconfig
CONFIG_RUST=y
CONFIG_RUST_APP_NAME="hello_world"
# minimal libc module is needed in order to suppress
# 'inttypes.h' not found error
CONFIG_MINIMAL_LIBC=y
CONFIG_BUILD_OUTPUT_UF2=n
CONFIG_QEMU_ICOUNT=n
```

## src/main.c
```c
/* External declaration for main in Rust. */
void rust_main(void);

int main(void)
{
	rust_main();

    return 0;
}
```
